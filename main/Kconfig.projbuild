## main/Kconfig.projbuild
```kconfig
menu "TiltMouse output"
    choice TILTMOUSE_OUTPUT
        prompt "Normal mouse output (startup only)"
        default TILTMOUSE_OUTPUT_USB
        config TILTMOUSE_OUTPUT_USB
            bool "Native USB mouse (default, no Wi-Fi)"
        config TILTMOUSE_OUTPUT_ESPNOW
            bool "Provisioned ESP-NOW to faikeow receiver"
    endchoice

    config TILTMOUSE_USB_DIAGNOSTICS
        bool "USB HID + CDC telemetry for physical qualification"
        depends on TILTMOUSE_OUTPUT_USB
        select TINYUSB_CDC_ENABLED
        default n
        help
            Add a diagnostic serial interface and redirect the existing bounded
            application logs to it. Normal wired firmware remains mouse-only.
            This interface accepts no application commands or synthetic input.

    config TILTMOUSE_SENSOR_INDICATOR
        bool "Very dim tilt dot for USB physical qualification"
        depends on TILTMOUSE_USB_DIAGNOSTICS
        default n
        help
            Drive the GPIO14 matrix with at most one colour channel at code 1
            on one pixel. A blue dot means calibration/freshness is pending;
            green shows recentered tilt. Updates are bounded and nonblocking.
            Normal USB and ESP-NOW defaults keep the matrix data quiescent.
endmenu
```
